## drivers/sensor/ds18b20/Kconfig
```kconfig
# DS18B20 temperature sensor configuration options

# Copyright (c) 2020 Alexander Mihajlovic <a@abxy.se>
# SPDX-License-Identifier: Apache-2.0

menuconfig DS18B20
	bool "DS18B20 sensor"
	depends on W1
	help
	  Enable driver for DS18B20 1-wire temperature sensor.
```

## drivers/w1/Kconfig
```kconfig
# 1-Wire configuration options

# Copyright (c) 2020 Alexander Mihajlovic <a@abxy.se>
# SPDX-License-Identifier: Apache-2.0

#
# W1 options
#
menuconfig W1
	bool "1-Wire Drivers"
	help
	  Enable 1-Wire Driver Configuration

if W1

# Include these first so that any properties (e.g. defaults) below can be
# overridden (by defining symbols in multiple locations)
source "drivers/w1/Kconfig.ds2482"
source "drivers/w1/Kconfig.w1_emul"

config W1_INIT_PRIORITY
	int "Init priority"
	default 80
	help
	  1-wire device driver initialization priority.

module = W1
module-str = w1
source "subsys/logging/Kconfig.template.log_config"

endif # W1
```

## drivers/w1/Kconfig.w1_emul
```kconfig
# Copyright (c) 2020 Alexander Mihalovic <a@abxy.se>
# SPDX-License-Identifier: Apache-2.0

config W1_EMUL
	bool "1-wire emulator"
	help
	  Enable the 1-wire emulator driver. This is a fake driver in that it
	  does not talk to real hardware. Instead it talks to emulation
	  drivers that pretend to be devices on the emulated 1-wire bus. It is
	  used for testing drivers for 1-wire devices.
```

## dts/bindings/sensor/maxim,ds18b20.yaml
```yaml
#
# Copyright (c) 2020 Alexander Mihajlovic <a@abxy.se>
#
# SPDX-License-Identifier: Apache-2.0
#

description: Maxim DS18B20 Temperature Sensor

compatible: "maxim,ds18b20"

include: w1-device.yaml
```

## dts/bindings/w1/w1-controller.yaml
```yaml
# Copyright (c) 2017 I-SENSE group of ICCS
# SPDX-License-Identifier: Apache-2.0

# Common fields for 1-wire controllers

include: base.yaml

bus: w1

properties:
    label:
      required: true
```

## dts/bindings/w1/w1-device.yaml
```yaml
# Copyright (c) 2020 Alexander Mihajlovic <a@abxy.se>
# SPDX-License-Identifier: Apache-2.0

# Common fields for 1-wire devices

include: base.yaml

on-bus: w1

properties:
    label:
      required: true
```

## dts/bindings/w1/zephyr,w1-emul.yaml
```yaml
description: Zephyr 1-Wire Emulation controller

compatible: "zephyr,w1-emul-controller"

include: w1-controller.yaml
```

## subsys/emul/w1/Kconfig
```kconfig
# Configuration options for 1-wire peripheral emulators

# Copyright (c) 2020 Alexander Mihajlovic <a@abxy.se>
# SPDX-License-Identifier: Apache-2.0

config EMUL_DS18B20
	bool "Emulate a Maxim DS18B20 temperature sensor"
	help
	  This is an emulator for the Maxim DS18B20 temperature sensor.
```
